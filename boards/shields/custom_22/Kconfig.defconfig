## boards/shields/custom_22/Kconfig.defconfig
```kconfig
config ZMK_BLE
    default y

config ZMK_SPLIT
    default y

if SHIELD_CUSTOM_22_DONGLE

config ZMK_USB
    default y

config ZMK_KEYBOARD_NAME
    default "Custom 22"

config ZMK_SPLIT_BLE_ROLE_CENTRAL
    default y

config ZMK_DISPLAY
    default y

config I2C
    default y

config SSD1306
    default y

config LV_Z_MEM_POOL_SIZE
    default 16384

config LV_Z_VDB_SIZE
    default 100

config LV_DPI_DEF
    default 148

config LV_Z_BITS_PER_PIXEL
    default 1

endif

if SHIELD_CUSTOM_22_LEFT || SHIELD_CUSTOM_22_RIGHT

config ZMK_SLEEP
    default y
    
endif
```
